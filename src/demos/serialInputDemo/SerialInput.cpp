#include <./demos/serialInputDemo/SerialInput.h>

/**
 * @brief This class is simply used to demonstrate handling
 * @ref Serial input. In the case of this example, the input
 * is generated by user input. In the real world, this could
 * be a user or another device.
 * 
 * This When entering text for this code to parse and echo
 * back, be sure to wrap it in @code< @endcode and @code> @endcode .
 * 
 * This code was originally published on the Arduino forum at:
 * https://forum.arduino.cc/t/serial-input-basics-updated/382007/2#example-3-a-more-complete-system-1
 * 
 * For a full write up and explanation of the @ref Serial
 * concepts demonstrated here, please refer to the
 * source article.
 * 
 */
void SerialInput::recvWithStartEndMarkers()
{
    static boolean recvInProgress = false;
    static byte ndx = 0;
    char startMarker = '<';
    char endMarker = '>';
    char rc;

    while (Serial.available() > 0 && _newData == false)
    {
        rc = Serial.read();

        if (recvInProgress == true)
        {
            if (rc != endMarker)
            {
                _receivedChars[ndx] = rc;
                ndx++;
                if (ndx >= _numChars)
                {
                    ndx = _numChars - 1;
                }
            }
            else
            {
                _receivedChars[ndx] = '\0'; // terminate the string
                recvInProgress = false;
                ndx = 0;
                _newData = true;
            }
        }
        else if (rc == startMarker)
        {
            recvInProgress = true;
        }
    }
}

void SerialInput::showNewData()
{
    if (_newData == true)
    {
        Serial.print("This just in ... ");
        Serial.println(_receivedChars);
        _newData = false;
    }
}